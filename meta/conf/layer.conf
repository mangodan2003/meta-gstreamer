## meta/conf/layer.conf
```bitbake
# We have a conf and classes directory, add to BBPATH
BBPATH .= ":${LAYERDIR}"

# We have recipes-* directories, add to BBFILES
BBFILES += "${LAYERDIR}/recipes-*/*/*.bb \
	        ${LAYERDIR}/recipes-*/*/*/*.bb \
            ${LAYERDIR}/recipes-*/*/*/*/*.bb \
            ${LAYERDIR}/recipes-*/*/*/*/*/*.bb \
            ${LAYERDIR}/recipes-*/*/*.bbappend \
"

BBFILE_COLLECTIONS += "gstreamer-latest"
BBFILE_PATTERN_gstreamer-latest = "^${LAYERDIR}/"
BBFILE_PRIORITY_gstreamer-latest = "11"

LAYERDEPENDS_gstreamer-latest = "core"
LAYERSERIES_COMPAT_gstreamer-latest = "kirkstone"

EA_LICENSE_PATH = "${LAYERDIR}/EA_LICENSE"
```
